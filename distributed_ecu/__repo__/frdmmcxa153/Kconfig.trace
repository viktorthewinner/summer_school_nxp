## distributed_ecu/__repo__/frdmmcxa153/Kconfig.trace
```kconfig
config CUSTOM_APP_LED_BLINKY_PERIPHERAL
    bool
    default y
    select MCUX_PRJSEG_config.arm.warn_as_error
    select MCUX_PRJSEG_config.arm.shared
    select MCUX_PRJSEG_config.mcx.shared
    select MCUX_PRJSEG_config.device_core.define
    select MCUX_PRJSEG_config.arm.core.fpu.no_fpu
    select MCUX_PRJSEG_config.arm.core.cm33_nodsp_nosau
    select MCUX_COMPONENT_CMSIS_Include_core_cm
    select MCUX_PRJSEG_module.device.suite
```
