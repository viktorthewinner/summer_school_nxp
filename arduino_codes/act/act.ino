/*
 * act.ino  --  ACT node (Arduino 2): motor drive, safe state, 1602A display.
 *
 * Run act_motor_test.ino FIRST and prove the wiring. This sketch is the same
 * drive stage with the VCU link on top, so if the motors misbehave here it is
 * almost certainly the link, not the hardware.
 *
 * ---------------------------------------------------------------------------
 * LINK  (SoftwareSerial D4/D5, 38400, to the MCX on LPUART1 - J2 pins 20/18)
 *
 *   in    D,<left>,<right>            duty 0..100 each
 *   in    M,<text>                    put text on the LCD (row 0)
 *   out   S,<left>,<right>,<age_ms>   5 Hz status
 *
 *   No command for CMD_TIMEOUT_MS -> both pairs to zero. That is the whole
 *   safety story on this node: it does not need to know why the VCU went away.
 *   Note the timeout watches D, lines only - a stream of M, lines is not a
 *   sign of life from the control loop and must not hold the motors on.
 *
 * Note there is no sign anywhere. A low-side switch conducts one way, so duty
 * is 0..100 and the car steers on the difference between the two channels.
 * One side at zero pivots it.
 *
 * SoftwareSerial disables interrupts while it transmits, which would matter if
 * anything here were timing-critical. It is not: the PWM is generated by Timer1
 * in hardware and keeps running regardless.
 *
 * ---------------------------------------------------------------------------
 * THE DISPLAY
 *
 *   row 0   whatever the laptop last sent. Longer than 16 characters and it
 *           marquees, because 16 characters is not a message.
 *   row 1   live drive state, so the car reports itself even with no laptop.
 *
 * Pins, wiring and the 2 kHz reasoning: see act_motor_test.ino and
 * SCHEMA_WIRING.svg blocks D and E.
 */

#include <SoftwareSerial.h>
#include <LiquidCrystal.h>

/* ---- configuration ------------------------------------------------------ */

static const uint8_t  PIN_LINK_RX = 4;    /* <- MCX P1_9, direct wire         */
static const uint8_t  PIN_LINK_TX = 5;    /* -> MCX P1_8, THROUGH THE DIVIDER */
static const uint8_t  PIN_PWM_L   = 9;    /* OC1A -> 470R -> Q1, Q2 bases     */
static const uint8_t  PIN_PWM_R   = 10;   /* OC1B -> 470R -> Q3, Q4 bases     */

static const uint32_t LINK_BAUD   = 38400;  /* must match LINK_BAUDRATE      */
static const uint32_t USB_BAUD    = 115200;

static const uint16_t PWM_TOP     = 4000;   /* 2 kHz, see act_motor_test.ino */
static const uint8_t  DUTY_MAX    = 70;
static const uint8_t  SLEW_STEP   = 4;
static const uint16_t SLEW_MS     = 20;

static const uint16_t CMD_TIMEOUT_MS = 300; /* VCU sends at 20 Hz            */
static const uint16_t STATUS_MS      = 200;
static const uint16_t DIAG_MS        = 2000;  /* console link readout */
static const uint8_t  LINE_MAX       = 64;

/* LCD: 16x2, 4-bit. LiquidCrystal(RS, E, DB4, DB5, DB6, DB7). */
static const uint8_t  LCD_COLS   = 16;
static const uint8_t  MSG_MAX    = 41;   /* 40 characters plus terminator */
static const uint16_t LCD_TICK_MS = 250; /* redraw and advance the marquee */
static const uint8_t  MARQUEE_GAP = 3;   /* blanks between wraps           */

/* ---- state -------------------------------------------------------------- */

SoftwareSerial link(PIN_LINK_RX, PIN_LINK_TX);
LiquidCrystal  lcd(6, 7, 8, 11, 12, A2);

static uint8_t  g_targetL, g_targetR;
static uint8_t  g_dutyL,   g_dutyR;
static uint32_t g_slewAt, g_statusAt, g_lastCmdAt, g_lcdAt, g_diagAt;
static uint32_t g_rxAt, g_rxLines, g_rxDrive;
static bool     g_safe = true;            /* true = stopped by timeout       */

static char     g_linkLine[LINE_MAX];
static uint8_t  g_linkLen;

static char     g_msg[MSG_MAX] = "waiting for VCU";
static uint8_t  g_msgLen       = 15;
static uint8_t  g_scroll;

/* ---- drive -------------------------------------------------------------- */

static void pwmApply(void)
{
  OCR1A = (uint16_t)(((uint32_t)PWM_TOP * g_dutyL) / 100UL);
  OCR1B = (uint16_t)(((uint32_t)PWM_TOP * g_dutyR) / 100UL);
}

static void driveInit(void)
{
  digitalWrite(PIN_PWM_L, LOW);
  digitalWrite(PIN_PWM_R, LOW);
  pinMode(PIN_PWM_L, OUTPUT);
  pinMode(PIN_PWM_R, OUTPUT);

  TCCR1A = 0;
  TCCR1B = 0;
  OCR1A  = 0;
  OCR1B  = 0;
  ICR1   = PWM_TOP;
  TCCR1A = _BV(COM1A1) | _BV(COM1B1) | _BV(WGM11);   /* phase correct, TOP=ICR1 */
  TCCR1B = _BV(WGM13)  | _BV(CS10);                  /* prescaler 1             */
}

static uint8_t clampDuty(long v)
{
  if (v < 0)              return 0;
  if (v > (long)DUTY_MAX) return DUTY_MAX;
  return (uint8_t)v;
}

static void slewService(void)
{
  if ((millis() - g_slewAt) < SLEW_MS) return;
  g_slewAt = millis();

  bool changed = false;
  if (g_dutyL != g_targetL) {
    if (g_dutyL < g_targetL) g_dutyL = (g_targetL - g_dutyL > SLEW_STEP) ? g_dutyL + SLEW_STEP : g_targetL;
    else                     g_dutyL = (g_dutyL - g_targetL > SLEW_STEP) ? g_dutyL - SLEW_STEP : g_targetL;
    changed = true;
  }
  if (g_dutyR != g_targetR) {
    if (g_dutyR < g_targetR) g_dutyR = (g_targetR - g_dutyR > SLEW_STEP) ? g_dutyR + SLEW_STEP : g_targetR;
    else                     g_dutyR = (g_dutyR - g_targetR > SLEW_STEP) ? g_dutyR - SLEW_STEP : g_targetR;
    changed = true;
  }
  if (changed) pwmApply();
}

/* Safe state. Zero the target AND the applied duty - do not ramp down, because
 * the reason we are here is that we no longer know what the VCU wants. */
static void safeState(void)
{
  g_targetL = g_targetR = 0;
  g_dutyL   = g_dutyR   = 0;
  pwmApply();
}

/* ---- display ------------------------------------------------------------
 * Every write is exactly LCD_COLS characters, space padded, so a shorter line
 * erases the tail of a longer one. lcd.clear() would do that too but it takes
 * 1.5 ms and flickers.
 * ------------------------------------------------------------------------ */

static void lcdRow(uint8_t row, const char *s)
{
  uint8_t i;
  bool    ended = false;

  lcd.setCursor(0, row);
  for (i = 0; i < LCD_COLS; i++) {
    if (!ended && s[i] == '\0') ended = true;   /* stop reading past the NUL */
    lcd.write(ended ? ' ' : s[i]);
  }
}

/* Row 0. Short messages sit still; long ones walk left one character per tick
 * with a few blanks between the end and the start, so the wrap is readable. */
static void lcdDrawMessage(void)
{
  char win[LCD_COLS + 1];
  uint8_t i;

  if (g_msgLen <= LCD_COLS) {
    for (i = 0; i < LCD_COLS; i++) win[i] = (i < g_msgLen) ? g_msg[i] : ' ';
  } else {
    uint16_t span = (uint16_t)g_msgLen + MARQUEE_GAP;
    for (i = 0; i < LCD_COLS; i++) {
      uint16_t k = (uint16_t)(g_scroll + i) % span;
      win[i] = (k < g_msgLen) ? g_msg[k] : ' ';
    }
    g_scroll = (uint8_t)((g_scroll + 1u) % span);
  }

  win[LCD_COLS] = '\0';
  lcdRow(0, win);
}

/* Row 1. This is the node describing itself, and it keeps working with the
 * laptop shut - which is exactly when you want to be able to read it. */
static void lcdDrawStatus(void)
{
  char row[LCD_COLS + 1];

  snprintf(row, sizeof(row), "L%-3u R%-3u %s",
           (unsigned)g_dutyL, (unsigned)g_dutyR, g_safe ? "SAFE" : "RUN");
  lcdRow(1, row);
}

static void lcdService(void)
{
  if ((millis() - g_lcdAt) < LCD_TICK_MS) return;
  g_lcdAt = millis();

  lcdDrawMessage();
  lcdDrawStatus();
}

static void messageSet(const char *s)
{
  uint8_t n = 0;

  while (s[n] != '\0' && n < (MSG_MAX - 1)) {
    /* The HD44780 has no glyphs below 0x20 and the link is ASCII anyway. */
    g_msg[n] = (s[n] >= 0x20 && s[n] < 0x7F) ? s[n] : ' ';
    n++;
  }
  g_msg[n] = '\0';
  g_msgLen = n;
  g_scroll = 0;

  Serial.print(F("[lcd] "));
  Serial.println(g_msg);
}

/* ---- link --------------------------------------------------------------- */

/* "D,<l>,<r>" - anything else is left for the console to print. */
static bool parseDrive(const char *s, long *l, long *r)
{
  if ((s[0] != 'D' && s[0] != 'd') || s[1] != ',') return false;

  const char *p = s + 2;
  char *end;
  *l = strtol(p, &end, 10);
  if (end == p || *end != ',') return false;
  p = end + 1;
  *r = strtol(p, &end, 10);
  if (end == p) return false;
  return true;
}

static void handleLinkLine(const char *s)
{
  long l, r;

  /* Anything arriving proves the forward path works, whatever it says. */
  g_rxAt = millis();
  g_rxLines++;

  /* The hub tags relayed traffic "[SRC] text"; step over that if present. */
  if (*s == '[') {
    const char *close = strchr(s, ']');
    if (close != NULL) { s = close + 1; while (*s == ' ') s++; }
  }

  if (parseDrive(s, &l, &r)) {
    g_targetL   = clampDuty(l);
    g_targetR   = clampDuty(r);
    g_lastCmdAt = millis();
    g_rxDrive++;
    if (g_safe) { g_safe = false; Serial.println(F("[link] commands resumed")); }
    return;
  }

  /* A message does NOT refresh g_lastCmdAt. Only a drive command counts as
   * the control loop being alive. */
  if ((s[0] == 'M' || s[0] == 'm') && s[1] == ',') {
    messageSet(s + 2);
    return;
  }

  Serial.print(F("[link] ")); Serial.println(s);
}

static void linkService(void)
{
  while (link.available()) {
    char c = (char)link.read();
    if (c == '\n' || c == '\r') {
      if (g_linkLen == 0) continue;
      g_linkLine[g_linkLen] = '\0';
      g_linkLen = 0;
      handleLinkLine(g_linkLine);
    } else if (g_linkLen < (LINE_MAX - 1)) {
      g_linkLine[g_linkLen++] = c;
    }
  }
}

static void statusService(void)
{
  if ((millis() - g_statusAt) < STATUS_MS) return;
  g_statusAt = millis();

  uint32_t age = millis() - g_lastCmdAt;
  if (age > 9999UL) age = 9999UL;

  char out[LINE_MAX];
  snprintf(out, sizeof(out), "S,%u,%u,%u",
           (unsigned)g_dutyL, (unsigned)g_dutyR, (unsigned)age);
  link.println(out);
}

static void timeoutService(void)
{
  if (g_safe) return;
  if ((millis() - g_lastCmdAt) > CMD_TIMEOUT_MS) {
    g_safe = true;
    safeState();
    Serial.println(F("[safe] no command from the VCU - motors stopped"));
  }
}

/* ---- diagnostics --------------------------------------------------------
 * The edge messages above already say when commands start and stop. This adds
 * the periodic view, so a console you glance at tells you whether the link is
 * alive without waiting for it to change state - and counts every line, so
 * "receiving nothing" and "receiving garbage" look different.
 * ------------------------------------------------------------------------ */

static void diagService(void)
{
  if ((millis() - g_diagAt) < DIAG_MS) return;
  g_diagAt = millis();

  Serial.print(F("[act] L"));
  Serial.print(g_dutyL);
  Serial.print(F(" R"));
  Serial.print(g_dutyR);
  Serial.print(g_safe ? F("  SAFE  ") : F("  RUN   "));
  Serial.print(F("VCU "));

  if (g_rxLines == 0) {
    Serial.println(F("NEVER HEARD. Check D4 <- MCX J2-20, and ground."));
    return;
  }

  Serial.print(millis() - g_rxAt);
  Serial.print(F(" ms ago, "));
  Serial.print(g_rxLines);
  Serial.print(F(" lines ("));
  Serial.print(g_rxDrive);
  Serial.println(F(" drive)"));
}

/* ---- entry -------------------------------------------------------------- */

void setup(void)
{
  driveInit();
  safeState();

  Serial.begin(USB_BAUD);
  link.begin(LINK_BAUD);

  lcd.begin(LCD_COLS, 2);
  lcdDrawMessage();
  lcdDrawStatus();

  g_lastCmdAt = millis() - CMD_TIMEOUT_MS - 1UL;   /* start in safe state */

  Serial.println(F("\nACT node ready."));
  Serial.println(F("  link  D4/D5 @ 38400 -> MCX LPUART1"));
  Serial.println(F("  in    D,<left>,<right>   duty 0..100"));
  Serial.println(F("  in    M,<text>           LCD row 0"));
  Serial.println(F("  out   S,<left>,<right>,<age_ms>"));
  Serial.print  (F("  stops after "));
  Serial.print  (CMD_TIMEOUT_MS);
  Serial.println(F(" ms without a DRIVE command."));
}

void loop(void)
{
  linkService();
  timeoutService();
  slewService();
  statusService();
  lcdService();
  diagService();
}
